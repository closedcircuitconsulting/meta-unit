## meta-freescale-extra/conf/layer.conf
```bitbake
BBPATH .= ":${LAYERDIR}"

BBFILES += "\
    ${LAYERDIR}/recipes-*/*/*.bb \
    ${LAYERDIR}/recipes-*/*/*.bbappend \
"

BBFILE_COLLECTIONS += "meta-freescale-extra"
BBFILE_PATTERN_meta-freescale-extra = "^${LAYERDIR}/"
BBFILE_PRIORITY_meta-freescale-extra = "6"

LAYERDEPENDS_meta-freescale-extra += "freescale-layer"

LAYERSERIES_COMPAT_meta-freescale-extra = "wrynose"

BBFILES_DYNAMIC += " \
    virtualization-layer:${LAYERDIR}/dynamic-layers/virtualization-layer/recipes-*/*/*.bb \
    virtualization-layer:${LAYERDIR}/dynamic-layers/virtualization-layer/recipes-*/*/*.bbappend \
"
```

## meta-rockchip-extra/conf/layer.conf
```bitbake
BBPATH .= ":${LAYERDIR}"

BBFILES += "\
    ${LAYERDIR}/recipes-*/*/*.bb \
    ${LAYERDIR}/recipes-*/*/*.bbappend \
"

BBFILE_COLLECTIONS += "rockchip-extra-layer"
BBFILE_PATTERN_rockchip-extra-layer = "^${LAYERDIR}/"
BBFILE_PRIORITY_rockchip-extra-layer = "2"

LAYERDEPENDS_rockchip-extra-layer += "rockchip"

LAYERSERIES_COMPAT_rockchip-extra-layer = "whinlatter"
```

## meta-sunxi-extra/conf/layer.conf
```bitbake
BBPATH .= ":${LAYERDIR}"

BBFILES += "\
    ${LAYERDIR}/recipes-*/*/*.bb \
    ${LAYERDIR}/recipes-*/*/*.bbappend \
"

BBFILE_COLLECTIONS += "sunxi-extra-layer"
BBFILE_PATTERN_sunxi-extra-layer = "^${LAYERDIR}/"
BBFILE_PRIORITY_sunxi-extra-layer = "11"

LAYERDEPENDS_sunxi-extra-layer += "sunxi"

LAYERSERIES_COMPAT_sunxi-extra-layer = "wrynose"

BBFILES_DYNAMIC += " \
    virtualization-layer:${LAYERDIR}/dynamic-layers/virtualization-layer/recipes-*/*/*.bb \
    virtualization-layer:${LAYERDIR}/dynamic-layers/virtualization-layer/recipes-*/*/*.bbappend \
"
```
