## meta-freescale-extra/conf/layer.conf
```bitbake
BBPATH .= ":${LAYERDIR}"

BBFILES += "\
    ${LAYERDIR}/recipes-*/*/*.bb \
    ${LAYERDIR}/recipes-*/*/*.bbappend \
"

BBFILE_COLLECTIONS += "meta-freescale-extra"
BBFILE_PATTERN_meta-freescale-extra = "^${LAYERDIR}/"
BBFILE_PRIORITY_meta-freescale-extra = "6"

LAYERDEPENDS_meta-freescale-extra += "freescale-layer"

LAYERSERIES_COMPAT_meta-freescale-extra = "whinlatter"
```

## meta-raspberrypi-extra/conf/layer.conf
```bitbake
BBPATH .= ":${LAYERDIR}"

BBFILES += "\
    ${LAYERDIR}/recipes-*/*/*.bb \
    ${LAYERDIR}/recipes-*/*/*.bbappend \
"

BBFILE_COLLECTIONS += "raspberrypi-extra-layer"
BBFILE_PATTERN_raspberrypi-extra-layer = "^${LAYERDIR}/"
BBFILE_PRIORITY_raspberrypi-extra-layer = "12"

LAYERDEPENDS_raspberrypi-extra-layer += "raspberrypi"

LAYERSERIES_COMPAT_raspberrypi-extra-layer = "whinlatter"
```

## meta-unit-core/conf/layer.conf
```bitbake
BBPATH .= ":${LAYERDIR}"

BBFILES += "${LAYERDIR}/recipes*/*/*.bb ${LAYERDIR}/recipes*/*/*.bbappend"

BBFILE_COLLECTIONS += "unit-core"
BBFILE_PATTERN_unit-core := "^${LAYERDIR}/"
BBFILE_PRIORITY_unit-core = "14"

LAYERDEPENDS_unit-distro = "core yocto unit-users-layer"

LAYERSERIES_COMPAT_unit-core = "wrynose"

BBFILES_DYNAMIC += " \
    raspberrypi-extra-layer:${LAYERDIR}/dynamic-layers/raspberrypi-extra-layer/recipes-*/*/*.bb \
    raspberrypi-extra-layer:${LAYERDIR}/dynamic-layers/raspberrypi-extra-layer/recipes-*/*/*.bbappend \
    unit-profiling-layer:${LAYERDIR}/dynamic-layers/unit-profiling-layer/recipes-*/*/*.bb \
    unit-profiling-layer:${LAYERDIR}/dynamic-layers/unit-profiling-layer/recipes-*/*/*.bbappend \
    raspberrypi:${LAYERDIR}/dynamic-layers/raspberrypi/recipes-*/*/*.bb \
    raspberrypi:${LAYERDIR}/dynamic-layers/raspberrypi/recipes-*/*/*.bbappend \
    rockchip:${LAYERDIR}/dynamic-layers/rockchip/recipes-*/*/*.bb \
    rockchip:${LAYERDIR}/dynamic-layers/rockchip/recipes-*/*/*.bbappend \
    unit-graphics-layer:${LAYERDIR}/dynamic-layers/unit-graphics-layer/recipes-*/*/*.bb \
    unit-graphics-layer:${LAYERDIR}/dynamic-layers/unit-graphics-layer/recipes-*/*/*.bbappend \
    unit-virtualization-layer:${LAYERDIR}/dynamic-layers/unit-virtualization-layer/recipes-*/*/*.bb \
    unit-virtualization-layer:${LAYERDIR}/dynamic-layers/unit-virtualization-layer/recipes-*/*/*.bbappend \
"

UNIT_CORE_LAYERDIR = "${LAYERDIR}"
```

## meta-unit-distro/conf/distro/include/containers.inc
```bitbake
require conf/distro/include/meta-virt-container-podman.inc

DISTRO_FEATURES:append = " virtualization"
DISTRO_FEATURES:append = " pam"

VIRTUAL-RUNTIME_dbus = "dbus-broker"
```

## meta-unit-distro/conf/distro/include/graphics.inc
```bitbake
DISTRO_FEATURES:remove = "directfb"
DISTRO_FEATURES:remove = "x11"

DISTRO_FEATURES:append = " wayland"
DISTRO_FEATURES:append = " pam"
DISTRO_FEATURES:append = " opengl"
```

## meta-unit-distro/conf/distro/include/initramfs.inc
```bitbake
INITRAMFS_IMAGE_BUNDLE = "1"
INITRAMFS_IMAGE = "core-image-unit-initramfs"

# The beaglebone-yocto machine configuration file does not handle the case where
# using kernel with bundled initramfs.
IMAGE_BOOT_FILES:remove:beaglebone-yocto = "${KERNEL_IMAGETYPE}"
IMAGE_BOOT_FILES:append:beaglebone-yocto = " ${KERNEL_IMAGETYPE}-${INITRAMFS_LINK_NAME}.bin;${KERNEL_IMAGETYPE}"
```

## meta-unit-distro/conf/distro/include/rpi-extra-image-boot-files-initramfs.conf
```bitbake
# Similar to what is found in meta-raspberrypi/conf/machine/include/rpi-base.inc,
# but will use kernel image with bundled initramfs if appropriate variables set
RPI_EXTRA_IMAGE_BOOT_FILES = " \
    ${@bb.utils.contains('RPI_USE_U_BOOT', '1', \
        '%s;Image u-boot.bin;%s boot.scr' % \
            (('${KERNEL_IMAGETYPE}-${INITRAMFS_LINK_NAME}.bin' if (d.getVar('INITRAMFS_IMAGE') and d.getVar('INITRAMFS_IMAGE_BUNDLE') == '1') else '${KERNEL_IMAGETYPE}'), \
             '${SDIMG_KERNELIMAGE}'), \
        '%s;%s' % \
            (('${KERNEL_IMAGETYPE}-${INITRAMFS_LINK_NAME}.bin' if (d.getVar('INITRAMFS_IMAGE') and d.getVar('INITRAMFS_IMAGE_BUNDLE') == '1') else '${KERNEL_IMAGETYPE}'), \
             '${SDIMG_KERNELIMAGE}'), \
        d)} \
"
```

## meta-unit-distro/conf/distro/include/rpi-graphics.conf
```bitbake
# Use full (not fake) KMS with raspberrypi3
VC4DTBO:raspberrypi3-64 = "vc4-kms-v3d"

# Since using full KMS with raspberrypi3, need special overlay 
# for the official DSI 7" touchscreen that is KMS compatible
RPI_EXTRA_CONFIG:append:raspberrypi3-64 = "\ndtoverlay=vc4-kms-dsi-7inch"

# Reserve some extra GPU memory
RPI_EXTRA_CONFIG:append:raspberrypi3-64 = "\ngpu_mem=128"
```

## meta-unit-distro/conf/distro/include/rpi.inc
```bitbake
require conf/distro/include/rpi-extra-image-boot-files-initramfs.conf
require conf/distro/include/rpi-graphics.conf
```

## meta-unit-distro/conf/distro/include/systemd.inc
```bitbake
INIT_MANAGER = "systemd"

# Don't symlink /var/log to /var/volatile/log 
# so persistent journal storage can be used.
FILESYSTEM_PERMS_TABLES:remove = "files/fs-perms-volatile-log.txt"
```

## meta-unit-distro/conf/distro/include/wic.inc
```bitbake
# This will override the default wic.xz for meta-rockchip.
WIC_COMPRESSION_EXTENSION = ".zst"

# This will override the default wic.bz2 for meta-raspberrypi.
IMAGE_FSTYPES:remove:rpi = "wic.bz2"
IMAGE_FSTYPES:append:rpi = " wic${WIC_COMPRESSION_EXTENSION}"

# Need to use a custom WIC kickstart file because the upstream
# one doesn't work with our kernel with bundled initramfs (boot
# partition not big enough).
WKS_FILE:beaglebone-yocto = "unit-beaglebone-yocto.wks"
```

## meta-unit-distro/conf/distro/unit-poky.conf
```bitbake
require conf/distro/poky.conf
require conf/distro/include/systemd.inc
require conf/distro/include/containers.inc
require conf/distro/include/graphics.inc
require conf/distro/include/wic.inc
require conf/distro/include/initramfs.inc
require conf/distro/include/rpi.inc

DISTRO = "unit-poky"
DISTRO_NAME = "Unit Poky"
DISTRO_VERSION = "0.1-snapshot-${DATE}"

MAINTAINER = "unitexe <unitexe70@gmail.com>"

DISTROOVERRIDES = "poky"
```

## meta-unit-distro/conf/layer.conf
```bitbake
BBPATH .= ":${LAYERDIR}"

BBFILES += "${LAYERDIR}/recipes*/*/*.bb ${LAYERDIR}/recipes*/*/*.bbappend"

BBFILE_COLLECTIONS += "unit-distro"
BBFILE_PATTERN_unit-distro := "^${LAYERDIR}/"
BBFILE_PRIORITY_unit-distro = "10"

LAYERDEPENDS_unit-distro = "core yocto virtualization-layer"

LAYERSERIES_COMPAT_unit-distro = "whinlatter"
```

## meta-unit-graphics/conf/layer.conf
```bitbake
BBPATH .= ":${LAYERDIR}"

BBFILES += "${LAYERDIR}/recipes*/*/*.bb ${LAYERDIR}/recipes*/*/*.bbappend"

BBFILE_COLLECTIONS += "unit-graphics-layer"
BBFILE_PATTERN_unit-graphics-layer := "^${LAYERDIR}/"
BBFILE_PRIORITY_unit-graphics-layer = "13"

LAYERDEPENDS_unit-distro = "core yocto unit-users-layer"

LAYERSERIES_COMPAT_unit-graphics-layer = "whinlatter"

BBFILES_DYNAMIC += " \
    flutter-layer:${LAYERDIR}/dynamic-layers/flutter-layer/recipes-*/*/*.bb \
    flutter-layer:${LAYERDIR}/dynamic-layers/flutter-layer/recipes-*/*/*.bbappend \
"

UNIT_GRAPHICS_LAYERDIR = "${LAYERDIR}"
```

## meta-unit-kas/conf/layer.conf
```bitbake
BBPATH .= ":${LAYERDIR}"

BBFILES += "${LAYERDIR}/recipes*/*/*.bb ${LAYERDIR}/recipes*/*/*.bbappend"

BBFILE_COLLECTIONS += "meta-unit-kas"
BBFILE_PATTERN_meta-unit-kas := "^${LAYERDIR}/"
BBFILE_PRIORITY_meta-unit-kas = "15"

LAYERDEPENDS_meta-unit-kas = "core"

LAYERSERIES_COMPAT_meta-unit-kas = "whinlatter"
```

## meta-unit-profiling/conf/layer.conf
```bitbake
BBPATH .= ":${LAYERDIR}"

BBFILES += "${LAYERDIR}/recipes*/*/*.bb ${LAYERDIR}/recipes*/*/*.bbappend"

BBFILE_COLLECTIONS += "unit-profiling-layer"
BBFILE_PATTERN_unit-profiling-layer := "^${LAYERDIR}/"
BBFILE_PRIORITY_unit-profiling-layer = "10"

LAYERDEPENDS_unit-profiling-layer = "core openembedded-layer"

LAYERSERIES_COMPAT_unit-profiling-layer = "whinlatter"

UNIT_PROFILING_LAYERDIR = "${LAYERDIR}"

BBFILES_DYNAMIC += " \
    raspberrypi:${LAYERDIR}/dynamic-layers/raspberrypi/*/*/*.bb \
    raspberrypi:${LAYERDIR}/dynamic-layers/raspberrypi/*/*/*.bbappend \
"
```

## meta-unit-users/conf/layer.conf
```bitbake
BBPATH .= ":${LAYERDIR}"

BBFILE_COLLECTIONS += "unit-users-layer"
BBFILE_PATTERN_unit-users-layer := "^${LAYERDIR}/"
BBFILE_PRIORITY_unit-users-layer = "6"

LAYERDEPENDS_unit-users-layer = "core"

LAYERSERIES_COMPAT_unit-users-layer = "whinlatter"
```

## meta-unit-virtualization/conf/layer.conf
```bitbake
BBPATH .= ":${LAYERDIR}"

BBFILES += "\
    ${LAYERDIR}/recipes-*/*/*.bb \
    ${LAYERDIR}/recipes-*/*/*.bbappend \
"

BBFILE_COLLECTIONS += "unit-virtualization-layer"
BBFILE_PATTERN_unit-virtualization-layer = "^${LAYERDIR}/"
BBFILE_PRIORITY_unit-virtualization-layer = "10"

LAYERDEPENDS_unit-virtualization-layer += "virtualization-layer virtualization-extra-layer unit-users-layer"

LAYERSERIES_COMPAT_unit-virtualization-layer = "wrynose"

UNIT_VIRTUALIZATION_LAYERDIR = "${LAYERDIR}"
```

## meta-virtualization-extra/conf/distro/distroless.inc
```bitbake
DISTRO_FEATURES = "acl ipv4 ipv6 largefile xattr"

VIRTUAL-RUNTIME_dev_manager ?= ""
VIRTUAL-RUNTIME_login_manager ?= ""
VIRTUAL-RUNTIME_init_manager ?= ""
VIRTUAL-RUNTIME_initscripts ?= ""
VIRTUAL-RUNTIME_keymaps ?= ""

PREFERRED_PROVIDER_virtual/kernel = "linux-dummy"
```

## meta-virtualization-extra/conf/distro/pokyless.conf
```bitbake
require conf/distro/poky.conf
require distroless.inc

DISTRO = "pokyless"
DISTRO_NAME = "Pokyless"
DISTRO_VERSION = "0.1.0"
DISTRO_CODENAME = "main"
SDK_VENDOR = "-pokylesssdk"

MAINTAINER = "unitexe <unitexe70@gmail.com>"

TARGET_VENDOR = "-pokyless"
```

## meta-virtualization-extra/conf/layer.conf
```bitbake
BBPATH .= ":${LAYERDIR}"

BBFILES += "\
    ${LAYERDIR}/recipes-*/*/*.bb \
    ${LAYERDIR}/recipes-*/*/*.bbappend \
"

BBFILE_COLLECTIONS += "virtualization-extra-layer"
BBFILE_PATTERN_virtualization-extra-layer = "^${LAYERDIR}/"
BBFILE_PRIORITY_virtualization-extra-layer = "9"

LAYERDEPENDS_virtualization-extra-layer += "core openembedded-layer virtualization-layer"

LAYERSERIES_COMPAT_virtualization-extra-layer = "wrynose"

VIRTUALIZATION_EXTRA_LAYERDIR = "${LAYERDIR}"
```

## meta-yocto-extra/conf/layer.conf
```bitbake
BBPATH .= ":${LAYERDIR}"

BBFILES += "\
    ${LAYERDIR}/recipes-*/*/*.bb \
    ${LAYERDIR}/recipes-*/*/*.bbappend \
"

BBFILE_COLLECTIONS += "yocto-extra-layer"
BBFILE_PATTERN_yocto-extra-layer = "^${LAYERDIR}/"
BBFILE_PRIORITY_yocto-extra-layer = "6"

LAYERDEPENDS_yocto-extra-layer += "yocto"

LAYERSERIES_COMPAT_yocto-extra-layer = "whinlatter"
```

## meta-yocto-extra/files/wic/unit-beaglebone-yocto.wks
```
# short-description: Create SD card image for Beaglebone
# long-description: Creates a partitioned SD card image for Beaglebone with increased size to allow for use with kernel with bundled initramfs that exceeds the upstream size of 32MB
# Boot files are located in the first vfat partition.

part /boot --source bootimg_partition --ondisk mmcblk0 --fstype=vfat --label boot --active --align 4 --fixed-size 64 --sourceparams="loader=u-boot" --use-uuid
part / --source rootfs --ondisk mmcblk0 --fstype=ext4 --label root --align 4 --use-uuid
bootloader --append="console=ttyS0,115200 splash video=HDMI-A-1:1024x600@60 vt.global_cursor_default=0"
```
